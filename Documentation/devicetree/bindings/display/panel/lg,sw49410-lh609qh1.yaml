## Documentation/devicetree/bindings/display/panel/lg,sw49410-lh609qh1.yaml
```yaml
# SPDX-License-Identifier: GPL-2.0
%YAML 1.2
---
$id: http://devicetree.org/schemas/display/panel/lg,sw49410-lh609qh1.yaml#
$schema: http://devicetree.org/meta-schemas/core.yaml#

title: LG LH609QH1 MIPI-DSI panel with SW49410 controller

maintainers:
  - Paul Sajna <sajattack@postmarketos.org>

description:
  LG LH609QH1 6.1" 1440x3120 MIPI DSI panel with SW49410 controller found in LG G7 ThinQ smartphone.

allOf:
  - $ref: panel-common.yaml#

properties:
  compatible:
    items:
      - const: lg,sw49410

  reg:
    maxItems: 1

  backlight:
    description: Backlight device reference

  reset-gpios:
    description: Reset pin reference

  vsp-supply:
    description: Positive voltage supply

  vsn-supply:
    description: Negative voltage supply

required:
  - compatible
  - reg
  - reset-gpios
  - port
  - vsp-supply
  - vsn-supply

unevaluatedProperties: false

examples:
  - |
    #include <dt-bindings/gpio/gpio.h>

    dsi {
        #address-cells = <1>;
        #size-cells = <0>;

        panel@0 {
            reg = <0>;
            compatible = "lg,sw49410-lh609qh1";

            backlight = <&pmi8998_wled>;
            reset-gpios = <&tlmm 6 GPIO_ACTIVE_LOW>;
            width-mm = <65>;
            height-mm = <140>;

            vsp-supply = <&lab>;
            vsn-supply = <&ibb>;

            pinctrl-0 = <&sde_dsi_active &sde_te_active_sleep>;
            pinctrl-1 = <&sde_dsi_sleep &sde_te_active_sleep>;
            pinctrl-names = "default", "sleep";

            port {
              panel_in: endpoint {
                remote-endpoint = <&mdss_dsi0_out>;
              };
            };
        };
    };
```

## Documentation/devicetree/bindings/display/panel/lg,sw49410.yaml
```yaml
# SPDX-License-Identifier: GPL-2.0-only OR BSD-2-Clause
%YAML 1.2
---
$id: http://devicetree.org/schemas/display/panel/lg,sw49410.yaml#
$schema: http://devicetree.org/meta-schemas/core.yaml#

title: LG SW49410 MIPI-DSI DDIC

maintainers:
  - Paul Sajna <sajattack@postmarketos.org>

description:
  The SW49410 is a display driver IC with connected panel.

  LG LH609QH1 6.1" 1440x3120 MIPI DSI panel using this DDIC is found in
  the LG G7 ThinQ smartphone.

allOf:
  - $ref: panel-common.yaml#

properties:
  compatible:
    items:
      - enum:
            # LG LH609QH1 6.1" 1440x3120 60Hz 13:6 ratio
          - lg,sw49410-lh609qh1
      - const: lg,sw49410

  reg:
    maxItems: 1

  port: true

  reset-gpios:
    description: Reset pin reference

  vsp-supply:
    description: Positive voltage supply

  vsn-supply:
    description: Negative voltage supply

required:
  - compatible
  - reg
  - reset-gpios
  - port
  - vsp-supply
  - vsn-supply

unevaluatedProperties: false

examples:
  - |
    #include <dt-bindings/gpio/gpio.h>

    dsi {
        #address-cells = <1>;
        #size-cells = <0>;

        panel@0 {
            reg = <0>;
            compatible = "lg,sw49410-lh609qh1", "lg,sw49410";

            backlight = <&pmi8998_wled>;
            reset-gpios = <&tlmm 6 GPIO_ACTIVE_LOW>;
            width-mm = <65>;
            height-mm = <140>;

            vsp-supply = <&lab>;
            vsn-supply = <&ibb>;

            pinctrl-0 = <&sde_dsi_active &sde_te_active_sleep>;
            pinctrl-1 = <&sde_dsi_sleep &sde_te_active_sleep>;
            pinctrl-names = "default", "sleep";

            port {
                panel_in: endpoint {
                    remote-endpoint = <&mdss_dsi0_out>;
                };
            };
        };
    };
```

## Documentation/devicetree/bindings/display/panel/samsung,ea8074.yaml
```yaml
# SPDX-License-Identifier: (GPL-2.0-only OR BSD-2-Clause)
%YAML 1.2
---
$id: http://devicetree.org/schemas/display/panel/samsung,ea8074.yaml#
$schema: http://devicetree.org/meta-schemas/core.yaml#

title: Samsung EA8074 AMOLED DDIC

maintainers:
  - FIXME

description: |
  The Samsung EA8074 is display driver IC with connect panel.

allOf:
  - $ref: panel-common.yaml#

properties:
  compatible:
    items:
      - enum:
           # Samsung 6.01 inch, 1080x2160 pixels
          - samsung,ea8074-ams601nt01
           # Samsung 6.21 inch, 1080x2248 pixels
          - samsung,ea8074-ams621rc
           # Samsung 5.9 inch, 1080x2160 pixels
          - samsung,ea8074-l590nt06
      - const: samsung,ea8074

  reg:
    maxItems: 1

  elvdd-supply:
    description: EL driving positive voltage supply

  elvss-supply:
    description: EL driving negative voltage supply

  vddio-supply:
    description: I/O voltage supply

required:
  - compatible
  - reg
  - reset-gpios
  - elvdd-supply
  - elvss-supply
  - vddio-supply

additionalProperties: false

examples:
  - |
    #include <dt-bindings/gpio/gpio.h>

    dsi {
        #address-cells = <1>;
        #size-cells = <0>;

        panel@0 {
            compatible = "samsung,ea8074-ams621rc", "samsung,ea8074";
            reg = <0>;

            reset-gpios = <&tlmm 6 GPIO_ACTIVE_LOW>;

            vddio-supply = <&vreg_l14a_1p8>;
            elvdd-supply = <&lab>;
            elvss-supply = <&ibb>;

            port {
                panel_in: endpoint {
                    remote-endpoint = <&dsi0_out>;
                };
            };
        };
    };

...
```

## Documentation/devicetree/bindings/input/cirrus,cs40l20.yaml
```yaml
# SPDX-License-Identifier: (GPL-2.0-only OR BSD-2-Clause)
%YAML 1.2
---
$id: http://devicetree.org/schemas/input/cirrus,cs40l20.yaml#
$schema: http://devicetree.org/meta-schemas/core.yaml#

title: Cirrus Logic CS40L20 Boosted Haptic Driver

maintainers:
  - David Heidelberg <david@ixit.cz>

description:
  The CS40L20 is a boosted haptic driver with an integrated HALO DSP that
  plays waveforms from a wavetable loaded by the host. It is controlled over
  I2C and drives an external boost inductor and capacitor whose values, and
  the peak current limit, must be programmed before the boost converter is
  enabled.

properties:
  compatible:
    const: cirrus,cs40l20

  reg:
    maxItems: 1

  interrupts:
    maxItems: 1
    description: TRIG_INTZ output.

  reset-gpios:
    maxItems: 1

  vdd-a-supply:
    description: VA, analog and digital core supply.

  vdd-p-supply:
    description: VP, battery supply for the boost converter.

  cirrus,boost-ind-nanohenry:
    $ref: /schemas/types.yaml#/definitions/uint32
    enum: [1000, 1200, 1500, 2200]
    description: Boost inductor value in nH.

  cirrus,boost-cap-microfarad:
    $ref: /schemas/types.yaml#/definitions/uint32
    minimum: 1
    description:
      Total equivalent boost capacitance on the VBST and VAMP pins in uF,
      derated at 11 V DC and rounded to the nearest integer.

  cirrus,boost-peak-milliamp:
    $ref: /schemas/types.yaml#/definitions/uint32
    minimum: 1600
    maximum: 4500
    multipleOf: 50
    description: Boost inductor peak current limit in mA.

required:
  - compatible
  - reg
  - reset-gpios
  - vdd-a-supply
  - vdd-p-supply
  - cirrus,boost-ind-nanohenry
  - cirrus,boost-cap-microfarad
  - cirrus,boost-peak-milliamp

additionalProperties: false

examples:
  - |
    #include <dt-bindings/gpio/gpio.h>
    #include <dt-bindings/interrupt-controller/irq.h>

    i2c {
        #address-cells = <1>;
        #size-cells = <0>;

        haptic-driver@43 {
            compatible = "cirrus,cs40l20";
            reg = <0x43>;
            interrupt-parent = <&tlmm>;
            interrupts = <88 IRQ_TYPE_LEVEL_LOW>;
            reset-gpios = <&tlmm 87 GPIO_ACTIVE_LOW>;
            vdd-a-supply = <&vreg_s4a_1p8>;
            vdd-p-supply = <&vph_pwr>;
            cirrus,boost-ind-nanohenry = <1000>;
            cirrus,boost-cap-microfarad = <4>;
            cirrus,boost-peak-milliamp = <4500>;
        };
    };
```

## Documentation/devicetree/bindings/input/touchscreen/siw,sw49410-ts-spi.yaml
```yaml
# SPDX-License-Identifier: (GPL-2.0 OR BSD-2-Clause)
%YAML 1.2
---
$id: http://devicetree.org/schemas/input/touchscreen/siw,sw49410-ts-spi.yaml#
$schema: http://devicetree.org/meta-schemas/core.yaml#

title: SiliconWorks SW49410 SPI touchscreen

maintainers:
  - Paul Sajna <sajattack@postmarketos.org>

description: SiliconWorks touchscreen connected with SPI

allOf:
  - $ref: touchscreen.yaml#
  - $ref: /schemas/spi/spi-peripheral-props.yaml#

properties:
  compatible:
    enum:
      - siw,sw49410-ts-spi

  interrupts:
    maxItems: 1

  reset-gpios:
    maxItems: 1

required:
  - compatible
  - interrupts
  - reset-gpios
  - touchscreen-size-x
  - touchscreen-size-y

unevaluatedProperties: false

examples:
  - |
    #include <dt-bindings/gpio/gpio.h>
    #include <dt-bindings/interrupt-controller/irq.h>

    &spi5 {
      clock-frequency = <5000000>;

      status = "okay";

      touchscreen@0 {
          compatible = "siw,sw49410-ts-spi";
          reg = <0>;
          interrupts-extended = <&tlmm 31 IRQ_TYPE_EDGE_FALLING>;
          spi-max-frequency = <5000000>;
          reset-gpio = <&tlmm 32 GPIO_ACTIVE_LOW>;
          panel = <&display_panel>;
          touchscreen-size-x = <1440>;
          touchscreen-size-y = <3120>;
        };
    };
...
```

## Documentation/devicetree/bindings/media/i2c/samsung,s5k3p9sp.yaml
```yaml
# SPDX-License-Identifier: GPL-2.0-only
%YAML 1.2
---
$id: http://devicetree.org/schemas/media/i2c/samsung,s5k3p9sp.yaml#
$schema: http://devicetree.org/meta-schemas/core.yaml#

title: Samsung S5K3P9SP Image Sensor

description:
  Samsung S5K3P9SP image sensor is a 16MP front camera sensor.
  The widest supported output image frame size is 4608x3456 at 30 frames
  per second, data output format is RAW10 transferred over a 4-lane MIPI
  CSI-2 D-PHY interface.

maintainers:
  - David Heidelberg <david@ixit.cz>

allOf:
  - $ref: /schemas/media/video-interface-devices.yaml#

properties:
  compatible:
    const: samsung,s5k3p9sp

  reg:
    maxItems: 1

  clocks:
    description: MCLK supply clock.
    maxItems: 1

  reset-gpios:
    description: Active low GPIO connected to RESET pad of the sensor.
    maxItems: 1

  vana-supply:
    description: Analogue voltage supply, 2.8 V.

  vdig-supply:
    description: Digital core voltage supply, 1.05 V.

  vio-supply:
    description: Digital I/O voltage supply, 1.8 V.

  port:
    $ref: /schemas/graph.yaml#/$defs/port-base
    additionalProperties: false

    properties:
      endpoint:
        $ref: /schemas/media/video-interfaces.yaml#
        unevaluatedProperties: false

        properties:
          data-lanes:
            items:
              - const: 1
              - const: 2
              - const: 3
              - const: 4

        required:
          - link-frequencies

required:
  - compatible
  - reg
  - port

unevaluatedProperties: false

examples:
  - |
      #include <dt-bindings/gpio/gpio.h>

      i2c {
          #address-cells = <1>;
          #size-cells = <0>;

          camera@2d {
              compatible = "samsung,s5k3p9sp";
              reg = <0x2d>;
              clocks = <&camera_mclk 0>;
              assigned-clocks = <&camera_mclk 0>;
              assigned-clock-rates = <24000000>;
              reset-gpios = <&gpio1 10 GPIO_ACTIVE_LOW>;
              vana-supply = <&vreg_2p8>;
              vdig-supply = <&vreg_1p05>;
              vio-supply = <&vreg_1p8>;

              port {
                  endpoint {
                      link-frequencies = /bits/ 64 <700000000>;
                      remote-endpoint = <&mipi_csi_in>;
                  };
              };
          };
      };
...
```

## Documentation/devicetree/bindings/power/supply/idt,p9221.yaml
```yaml
# SPDX-License-Identifier: (GPL-2.0-only OR BSD-2-Clause)
%YAML 1.2
---
$id: http://devicetree.org/schemas/power/supply/idt,p9221.yaml#
$schema: http://devicetree.org/meta-schemas/core.yaml#

title: IDT P9221 Qi Wireless Power Receiver

maintainers:
  - David Heidelberg <david@ixit.cz>

description: |
  The IDT (now Renesas) P9221-R is a Qi-compliant wireless power receiver
  for up to 15W applications. It rectifies the coil voltage and provides a
  regulated 5V (BPP) or 9V (EPP) output that is typically fed into the
  system charger. The receiver is powered solely from the coil, so it is
  only reachable over I2C while it sits on a transmitter pad.

  The receiver runs a Cortex-M0 firmware which defines most of the register
  map. Devices shipped with customer-specific firmware (customer ID register
  0x03) may use a different map than the public datasheet.

allOf:
  - $ref: power-supply.yaml#

properties:
  compatible:
    const: idt,p9221

  reg:
    maxItems: 1

  interrupts:
    items:
      - description: INT pin, open-drain, active-low fault/status interrupt
      - description:
          VDD18 rail power-good, rises when the receiver powers up in field

  interrupt-names:
    items:
      - const: int
      - const: pg

  enable-gpios:
    description: GPIO connected to the active-low EN pin
    maxItems: 1

  idt,fod-bpp:
    $ref: /schemas/types.yaml#/definitions/uint8-array
    minItems: 2
    maxItems: 16
    description:
      Foreign Object Detection calibration written to the receiver when
      operating in Baseline Power Profile (5V) mode. The values are
      board-specific gain/offset pairs generated by the vendor tooling.

  idt,fod-epp:
    $ref: /schemas/types.yaml#/definitions/uint8-array
    minItems: 2
    maxItems: 16
    description:
      Foreign Object Detection calibration written to the receiver when
      operating in Extended Power Profile (9V) mode.

required:
  - compatible
  - reg
  - interrupts
  - interrupt-names

unevaluatedProperties: false

examples:
  - |
    #include <dt-bindings/gpio/gpio.h>
    #include <dt-bindings/interrupt-controller/irq.h>

    i2c {
        #address-cells = <1>;
        #size-cells = <0>;

        charger@61 {
            compatible = "idt,p9221";
            reg = <0x61>;

            interrupts-extended = <&tlmm 124 IRQ_TYPE_LEVEL_LOW>,
                                  <&tlmm 36 IRQ_TYPE_EDGE_BOTH>;
            interrupt-names = "int", "pg";

            enable-gpios = <&tlmm 122 GPIO_ACTIVE_LOW>;

            idt,fod-bpp = /bits/ 8 <0xa8 0x28 0x86 0x34 0x82 0x38
                                    0x9a 0x12 0x9c 0x0b 0x84 0x65>;
            idt,fod-epp = /bits/ 8 <0xa4 0x2a 0x86 0x36 0x84 0x3d
                                    0x9a 0x14 0x9d 0x0b 0xa2 0xfb>;
        };
    };
```

## Documentation/devicetree/bindings/sound/nxp,tfa98xx.yaml
```yaml
# SPDX-License-Identifier: (GPL-2.0-only OR BSD-2-Clause)
%YAML 1.2
---
$id: http://devicetree.org/schemas/sound/nxp,tfa98xx.yaml#
$schema: http://devicetree.org/meta-schemas/core.yaml#

title: NXP/Goodix TFA98XX Smart Speaker Amplifier

maintainers:
  - phone-devel@vger.kernel.org

description: |
  The TFA98XX family are I2C-controlled smart speaker amplifiers featuring
  an on-chip CoolFlux DSP and a Class-D amplifier. The driver loads a
  vendor-supplied container firmware file (tfa98xx.cnt) to configure the DSP.

allOf:
  - $ref: dai-common.yaml#

properties:
  compatible:
    enum:
      - nxp,tfa9872
      - nxp,tfa9873
      - nxp,tfa9874
      - nxp,tfa9875
      - nxp,tfa9878
      - nxp,tfa9888
      - nxp,tfa9894
      - nxp,tfa9912

  reg:
    maxItems: 1

  reset-gpios:
    maxItems: 1
    description: GPIO connected to the RST pin (active high).

  irq-gpios:
    maxItems: 1
    description: GPIO connected to the interrupt output pin (active low).

  '#sound-dai-cells':
    const: 0

required:
  - compatible
  - reg

unevaluatedProperties: false

examples:
  - |
    #include <dt-bindings/gpio/gpio.h>
    i2c {
        #address-cells = <1>;
        #size-cells = <0>;

        amplifier@34 {
            compatible = "nxp,tfa9874";
            reg = <0x34>;
            reset-gpios = <&tlmm 69 GPIO_ACTIVE_HIGH>;
            #sound-dai-cells = <0>;
        };
    };
```
